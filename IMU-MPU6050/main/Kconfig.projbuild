## IMU-MPU6050/main/Kconfig.projbuild
```kconfig
menu "WiFi configuration"

	choice ESP_WIFI_MODE
		prompt "AP or STA"
		default ESP_WIFI_IS_STATION
		help
			Whether the esp32 is softAP or station.
			
	config ESP_WIFI_IS_SOFTAP                                      
		bool "SoftAP"                                              
	config ESP_WIFI_IS_STATION                                     
		bool "Station"                                             
	endchoice
    
	config ESP_WIFI_MODE_AP
		bool
		default y if ESP_WIFI_IS_SOFTAP                            
		default n if ESP_WIFI_IS_STATION 

	config WIFI_SSID
		string "Wifi SSID"
		default "esp32-ap"
		help
			SSID for the Access Point Wifi network (max 31 chars)

	config WIFI_PASSWORD
		string "Wifi password"
		help
			Password for the Wifi network (if needed)

	config WIFI_CHANNEL
	int "Wifi channel"
		default 0
		help
			Channel for the Wifi network
	
	choice
		prompt "Authentication mode"
		default WIFI_AUTH_WPA2_PSK
		help
			Authentication mode for the Wifi network
		config WIFI_AUTH_OPEN
			bool "Open"
		config WIFI_AUTH_WEP
			bool "WEP"
		config WIFI_AUTH_WPA_PSK
			bool "WPA-PSK"
		config WIFI_AUTH_WPA2_PSK
			bool "WPA2-PSK"
		config WIFI_AUTH_WPA_WPA2_PSK
			bool "WPA-PSK or WPA2-PSK"
		config WIFI_AUTH_WPA2_ENTERPRISE
			bool "WPA2 Enterprise"			
	endchoice
	
	config WIFI_HIDE_SSID
		bool "Hide SSID"
		default 0
		help
			Hide SSID
	
	config WIFI_MAX_CONNECTIONS
		int "Maximum concurrent connections"
		range 1 4
		default 4
		help
			Maximum number of concurrent connections (1-4)
	
	config WIFI_BEACON_INTERVAL	
		int "Beacon interval (ms)"
		range 100 60000
		default 100
		help
			Beacon interval in ms (100-60000)
			
endmenu
menu "IMU Configure"
	choice
		prompt "IMU type"
		default IMU_MPU6050
		config IMU_MPU6050
			bool "MPU6050"
		config IMU_MPU9250
			bool "MPU9250"
	endchoice
endmenu
```

## RobotArm-Controller/main/Kconfig.projbuild
```kconfig
menu "RobtoArm configuration"

	menu "I/O configuration"
	config PIN_LED
		int "LED gpio pin"
		default 23
		help
			LED pin
	
	config PIN_MOTOR_1	
		int "Motor 1 gpio pin"
		default 2
		help
			Motor 1 pin
			
	config PIN_MOTOR_2	
		int "Motor 2 gpio pin"
		default 4
		help
			Motor 2 pin
			
	config PIN_MOTOR_3	
		int "Motor 3 gpio pin"
		default 21
		help
			Motor 3 pin
			
	config PIN_MOTOR_4	
		int "Motor 4 gpio pin"
		default 22
		help
			Motor 4 pin
			
	config PIN_MOTOR_5	
		int "Motor 5 gpio pin"
		default 18
		help
			Motor 5 pin
			
	config PIN_MOTOR_6	
		int "Motor 6 gpio pin"
		default 5
		help
			Motor 6 pin
	endmenu
	
	menu "WiFi configuration"
	config WIFI_SSID
		string "Wifi SSID"
		default "esp32-ap"
		help
			SSID for the Access Point Wifi network (max 31 chars)

	config WIFI_PASSWORD
		string "Wifi password"
		help
			Password for the Wifi network (if needed)
			
	config WIFI_CHANNEL
		int "wi-fi channel"
		default 6
		help
			wi-fi channel
			
	config AP_HIDE_SSID
            int "Hide SSID"
            default 0
            help
                    Hide SSID

    config AP_MAX_CONNECTIONS
            int "Maximum concurrent connections"
            range 1 4
            default 4
            help
                    Maximum number of concurrent connections (1-4)

    config AP_BEACON_INTERVAL
            int "Beacon interval (ms)"
            range 100 60000
            default 100
            help
                    Beacon interval in ms (100-60000)
	endmenu
endmenu
```
